## Kconfig
```kconfig
# SPDX-License-Identifier: BSD-2-Clause

mainmenu "Virtioso build configuration"

choice
    prompt "Target Architecture"
    default ARCH_ARM64

config ARCH_ARM64
    bool "ARM64"

config ARCH_X86_64
    bool "x86_64"

endchoice

config ARCH
    string
    default "arm64" if ARCH_ARM64
    default "x86_64" if ARCH_X86_64

config SEL4_ARCH
    string
    default "aarch64" if ARCH_ARM64
    default "x86_64" if ARCH_X86_64

source "Kconfig.platform"
source "Kconfig.kernel"
source "Kconfig.debug"
source "Kconfig.capdl"

config CROSS_COMPILER_PREFIX
    string "Cross compiler prefix"
    default "aarch64-linux-gnu-" if ARCH_ARM64
    default "" if ARCH_X86_64
    help
      Prefix for cross-compilation toolchain.
      For ARM64: aarch64-linux-gnu-
      For x86_64 native builds, leave empty.
```

## Kconfig.capdl
```kconfig
# SPDX-License-Identifier: BSD-2-Clause
#
# CapDL Loader Options
#
# These mirror the options in capdl-loader-app/CMakeLists.txt

menuconfig CAPDL_LOADER
    bool "CapDL Loader Options"
    default y
    help
      Configure CapDL loader settings.
      Enabled by default with CMake-equivalent defaults.

if CAPDL_LOADER

choice
    prompt "Calling convention"
    default CAPDL_LOADER_CC_STANDARD
    help
      Select the calling convention that loaded processes are expecting.
      If you select the register convention you will be limited to passing
      four arguments to processes and their stack frames will not need to
      be mapped in during thread configuration.

config CAPDL_LOADER_CC_STANDARD
    bool "Standard"
    help
      Use standard calling convention with stack-based arguments.

config CAPDL_LOADER_CC_REGISTERS
    bool "Registers"
    help
      Use register-based calling convention. Limited to four arguments.

endchoice

config CAPDL_LOADER_MAX_OBJECTS
    int "Maximum number of objects"
    default 4096
    help
      Maximum number of objects that can be handled by the loader.
      Note that there is an upper limit on this based on the size
      of the initialiser's CNode.

config CAPDL_LOADER_FILLS_PER_FRAME
    int "Maximum fill commands per frame"
    default 1
    help
      Maximum number of fill commands per frame.

config CAPDL_LOADER_WRITEABLE_PAGES
    bool "Map all pages as writeable"
    default n
    help
      CapDL Loader will map all pages as writeable if the cap has grant
      permissions. This is currently used to enable instruction and data
      rewriting by an external debugger such as GDB.

config CAPDL_LOADER_PRINT_DEVICE_INFO
    bool "Print device frame information"
    default n
    help
      Dump device frame information on startup for debugging purposes.

config CAPDL_LOADER_PRINT_UNTYPEDS
    bool "Print untyped object information"
    default n
    help
      Dump untyped object information on startup for debugging purposes.

config CAPDL_LOADER_PRINT_CAPDL_OBJECTS
    bool "Print capDL objects verbosely"
    default n
    help
      Display verbose capDL objects as they are created. Could help with
      debugging, but for large specs with lots of objects, this could
      slow things down significantly.

config CAPDL_LOADER_STATIC_ALLOC
    bool "Static allocation mode"
    default n
    help
      Build the loader to expect a statically allocated capDL spec.

endif # CAPDL_LOADER
```

## Kconfig.debug
```kconfig
# SPDX-License-Identifier: BSD-2-Clause
#
# Debug and Tracing Options
#

menuconfig KERNEL_DEBUG
    bool "Kernel Debugging Options"
    default n
    help
      Enable kernel debugging and tracing features.
      These add overhead and should be disabled for production.

if KERNEL_DEBUG

config KERNEL_FTRACE_BUFFER
    bool "Enable ftrace buffer"
    default n
    help
      Enable kernel function tracing infrastructure.
      Provides a ring buffer for recording kernel events,
      RAS errors, and optional function traces.

      This is the base infrastructure - enable KERNEL_FUNCTION_TRACE
      for actual function enter/exit tracing.

config KERNEL_FUNCTION_TRACE
    bool "Function enter/exit tracing"
    depends on KERNEL_FTRACE_BUFFER
    default n
    help
      Instrument all kernel functions with enter/exit tracing
      using -finstrument-functions compiler flag.

      WARNING: This has HIGH performance overhead and generates
      large amounts of trace data. Only enable for debugging.

config KERNEL_MEM_DEBUG_PRINTING
    bool "Verbose memory debug printing"
    default y
    help
      Print verbose output about free memory initialization and
      creation of untyped regions during kernel boot.

      Useful for debugging memory layout issues.

config SEL4_TRACE
    bool "seL4 kernel tracing"
    default n
    help
      Enable seL4 kernel entry/exit tracing and PMU export.
      Sets KERNEL_ARM_EXPORT_PMU_USER.

config KERNEL_ARM_EXPORT_PMU_USER
    bool
    default y if SEL4_TRACE
    default n

config VIRTIO_VM_DEBUG
    bool "Verbose virtio VM and cross-VM debug logging"
    default n
    help
      Enable high-volume VM/VMM diagnostics for virtio and cross-VM interrupt
      investigation. This logs each cross-VM event and Linux sel4_virt ioreq
      wakeup path, so keep it disabled for normal boot and runtime testing.

config KERNEL_FTRACE_FORCE_TRACK_KERNEL_ENTRIES
    bool "Force track_kernel_entries with ftrace buffer"
    depends on KERNEL_FTRACE_BUFFER
    default y if KERNEL_FTRACE_BUFFER
    default n
    help
      When enabled, KERNEL_FTRACE_BUFFER automatically enables
      track_kernel_entries benchmark mode. Disable this to keep the ftrace
      buffer active with lower event volume.

config KERNEL_BENCHMARKS
    string
    default "track_kernel_entries" if SEL4_TRACE || KERNEL_FTRACE_FORCE_TRACK_KERNEL_ENTRIES
    default ""
    help
      Kernel benchmark mode. Set automatically based on other options.

endif # KERNEL_DEBUG

config VM_IMAGE_LOAD_TIMING
    bool "VM image load timing"
    default n
    help
      Emit one timing line per CAmkES ARM VM image-loading step. This is useful
      for diagnosing slow pre-kernel guest loading around "Loading Kernel".
      Keep disabled for normal boot and runtime testing.

config KMOD_SEL4_VIRT_STATS
    bool "kmod-sel4-virt RPC/doorbell counters"
    default n
    help
      Enable rate-limited sel4_virt_stats kernel log lines from the Linux
      sel4_virt module. The counters are useful for diagnosing whether
      inter-VM doorbells, IRQ handling, queued work, empty work passes, or
      userspace poll readiness are burning CPU while VM1 is still loading.
      Keep disabled for normal boot and runtime testing.
```

## Kconfig.kernel
```kconfig
# SPDX-License-Identifier: BSD-2-Clause
#
# seL4 Kernel Options
#

menu "Kernel Options"

config HYPERVISOR
    bool "Enable hypervisor support"
    default y
    help
      Enable the architecture-specific seL4 hypervisor/virtualization mode.
      This maps to EL2 support on ARM64 and VTX support on x86_64.

config ARM_HYP
    bool
    default y if HYPERVISOR && ARCH_ARM64

config VTX
    bool
    default y if HYPERVISOR && ARCH_X86_64

endmenu
```

## Kconfig.platform
```kconfig
# SPDX-License-Identifier: BSD-2-Clause
#
# Platform Selection
#

menu "Platform Selection"

choice
    prompt "Target Platform"
    default PLATFORM_ORINAGX if ARCH_ARM64
    default PLATFORM_QEMU_PC99 if ARCH_X86_64
    help
      Select the target hardware platform.

config PLATFORM_ORINAGX
    bool "NVIDIA Orin AGX"
    depends on ARCH_ARM64
    help
      NVIDIA Jetson AGX Orin development kit.
      Uses UEFI boot with EFI stub.

config PLATFORM_RPI4
    bool "Raspberry Pi 4"
    depends on ARCH_ARM64
    help
      Raspberry Pi 4 Model B.

config PLATFORM_QEMU_ARM_VIRT
    bool "QEMU ARM Virt"
    depends on ARCH_ARM64
    help
      QEMU ARM Virtual Machine (qemu-system-aarch64 -M virt).
      Useful for testing without hardware.

config PLATFORM_QEMU_PC99
    bool "QEMU PC99"
    depends on ARCH_X86_64
    help
      QEMU PC99 virtual machine (64 bit).
      Useful for testing without hardware.

config PLATFORM_PC99
    bool "PC99"
    depends on ARCH_X86_64
    help
      Real x86_64 hardware using the seL4 PC99 platform.

endchoice

config BUILD_TARGET
    string
    default "orinagx" if PLATFORM_ORINAGX
    default "rpi4" if PLATFORM_RPI4
    default "qemu-arm-virt" if PLATFORM_QEMU_ARM_VIRT
    default "qemu_pc99" if PLATFORM_QEMU_PC99
    default "pc99" if PLATFORM_PC99

config PLATFORM
    string
    default "orinagx" if PLATFORM_ORINAGX
    default "rpi4" if PLATFORM_RPI4
    default "qemu-arm-virt" if PLATFORM_QEMU_ARM_VIRT
    default "pc99" if PLATFORM_QEMU_PC99 || PLATFORM_PC99

config SIMULATION
    bool
    default y if PLATFORM_QEMU_ARM_VIRT
    default y if PLATFORM_QEMU_PC99
    default n

config NUM_NODES
    int
    default 12 if PLATFORM_ORINAGX
    default 4 if PLATFORM_RPI4
    default 2 if PLATFORM_QEMU_ARM_VIRT
    default 1 if PLATFORM_QEMU_PC99 || PLATFORM_PC99
    help
      Platform-specific CPU topology. This remains internal to the build
      system so all supported cores are always brought up for the
      selected platform.

config ELFLOADER_IMAGE
    string
    default "efi" if PLATFORM_ORINAGX
    default ""
    depends on ARCH_ARM64
    help
      Elfloader image type. Set to "efi" for UEFI boot.

config MACHINE
    string "Yocto machine name"
    default "vm-jetson-agx-orin" if PLATFORM_ORINAGX
    default "vm-raspberrypi4-64" if PLATFORM_RPI4
    default ""
    depends on ARCH_ARM64
    help
      Machine name for Yocto builds.

config DT_BINDINGS_PATH
    string "Path to dt-bindings headers for DTS compilation"
    default ""
    depends on PLATFORM_ORINAGX
    help
      Path to directory containing dt-bindings headers (clock, reset, etc.)
      for device tree preprocessing. When set, DTS files can use:
        #include <dt-bindings/clock/tegra234-clock.h>

      For Orin AGX, use the nvidia-kernel-oot headers from Yocto build.

endmenu
```

## configs/isengard_agx_orin_defconfig
```kconfig
CONFIG_ARCH_ARM64=y
CONFIG_PLATFORM_ORINAGX=y
CONFIG_MACHINE="isengard-agx-orin"
# CONFIG_HYPERVISOR is not set
```

## configs/orinagx_defconfig
```kconfig
CONFIG_ARCH_ARM64=y
CONFIG_PLATFORM_ORINAGX=y
CONFIG_DT_BINDINGS_PATH="/home/hlyytine/tii-sel4/vm-images/build/tmp/sysroots-components/vm_jetson_agx_orin/nvidia-kernel-oot/usr/src/device-tree/nvidia/t23x/nv-public/include/kernel"
```
